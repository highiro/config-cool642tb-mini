## config/west.yml
```yaml
manifest:  
  remotes:  
    - name: zmkfirmware  
      url-base: https://github.com/zmkfirmware  
    - name: na-ka-no
      url-base: https://github.com/na-ka-no
  
  projects:  
    - name: zmk
      remote: na-ka-no  # フォークしたリポジトリを参照  
      revision: for-cool642tb_mini  # カスタムブランチ名  
      import: app/west.yml  
      # 以下を追加してZephyr本体を3.5にピン留めする
    - name: zephyr
      revision: v3.5.0
    - name: zmk-pmw3610-driver  
      remote: na-ka-no
      revision: main
      
  
  self:  
    path: config
```
